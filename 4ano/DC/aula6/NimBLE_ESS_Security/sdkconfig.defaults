## 4ano/DC/aula6/NimBLE_ESS_Security/sdkconfig.defaults
```kconfig
CONFIG_BT_ENABLED=y
CONFIG_BT_NIMBLE_ENABLED=y
CONFIG_BT_NIMBLE_50_FEATURE_SUPPORT=n
CONFIG_BT_NIMBLE_SM_SC=y
CONFIG_BT_NIMBLE_NVS_PERSIST=y

CONFIG_BLINK_LED_GPIO=y
CONFIG_BLINK_GPIO=8
```
